## examples/settings_labels/Kconfig
```kconfig
# Kconfig demonstrating setting_labels for shell-tainted symbols.

mainmenu "Setting Labels example"

config ENABLED
	bool "Enable feature"
	default n
	help
	  Example boolean option.

config VERSION
	int
	default $(shell,echo 99)
	help
	  Version derived from the build environment.
	  The $(shell,...) default cannot be resolved at repository-rule
	  time; use setting_labels to supply the value from a custom rule.
```

## examples/simple/Kconfig
```kconfig
# Minimal Kconfig for rules_kconfig examples.
# See https://www.kernel.org/doc/html/latest/kbuild/kconfig-language.html

mainmenu "Simple example Kconfig"

config FOO
	bool "Enable FOO"
	default n
	help
	  Example boolean option.

config COUNT
	int "Count"
	default 3
	help
	  Example integer option.

config LABEL
	string "Label"
	default "hello"
	help
	  Example string option.
```
